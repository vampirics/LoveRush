#include <Arduboy2.h>
#include <ArduboyTones.h>

#define EEPROM_START_C1                 (EEPROM_STORAGE_SPACE_START + 128)
#define EEPROM_START_C2                 (EEPROM_START_C1 + 1)
#define EEPROM_SCORE                    (EEPROM_START_C1 + 2)

Arduboy2 arduboy;
ArduboyTones sound(arduboy.audio.enabled);
Sprites sprite;

// setting up variables

struct Position {
  int8_t x;
  int8_t y;
};

Position player = { 54, 40 };
Position cloudl = { 0, 0 };
Position cloudr = { 103, 0 };
Position en1 = { 0, 0 };
Position en2 = { 0, 0 };
Position expl1 = { 0, 0 };
Position expl2 = { 0, 0 };
Position heartminus = { 0, 0 };
Position fuelpower = { 50, 0 };

// Globals
const uint8_t FPS = 60;
uint8_t powerUpCounter = 0;

uint8_t state = 0;

// variable for Cloud backdrop
int8_t backdropx = -3;
int8_t backdropy = 0;

// variable for enemy position
int8_t enemy1x = random(26,87);
int8_t enemy1y = -28;
int8_t enemy2x = random(26,87);
int8_t enemy2y = -28;

// variable for heart position
int8_t heartx = random(26,87);
int8_t hearty = -14;

uint8_t shipFrame = 0;
uint8_t enemyFrame = 0;
uint8_t heartFrame = 0;
uint8_t heartminusFrame = 0;
uint8_t explosionFrame = 0;
uint8_t fuelFrame = 0;
uint8_t powerup1Frame = 0;

int8_t shield = 3;
bool primed = false;

bool hit = false;
bool hearthit = false;
bool gotpowerup = false;

int8_t speed = 1;
uint16_t fueltimer = 0;
uint16_t fuelcount = 0;

uint16_t ledTimer = 0;
uint16_t ledTimerg = 0;
uint16_t ledTimerb = 0;
uint16_t flashtimer = 0;

int8_t ee1 = 0;
int8_t ee2 = 0;

int8_t heartcounter = 0;

uint8_t fadeWidth;

// score variables
uint16_t score = 0;
uint16_t highScore = 0;

// Extract individual digits of a uint8_t
template< size_t size > void extractDigits(uint8_t (&buffer)[size], uint8_t value)
{
  for(uint8_t i = 0; i < size; ++i)
  {
    buffer[i] = value % 10;
    value /= 10;
  }
}

// Extract individual digits of a uint16_t
template< size_t size > void extractDigits(uint8_t (&buffer)[size], uint16_t value)
{
  for(uint8_t i = 0; i < size; ++i)
  {
    buffer[i] = value % 10;
    value /= 10;
  }
}

// storing sprites in PROGMEM
const unsigned char PROGMEM bootlogo[] =
{
// width, height,
//128, 64,
0x00, 0x00, 0x00, 0x00, 0x00, 0x00, 0x00, 0x00, 0x00, 0x00, 0x00, 0x00,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 0x00, 
0x00, 0x00, 0x00, 0x00, 0x00, 0x00, 0x00, 0x00, 0x00, 0x00, 0x00, 0x00,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 0x00, 
0x00, 0x00, 0x00, 0x00, 0x00, 0x00, 0x00, 0x00, 0x00, 0x00, 0x00, 0x00,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 0x00, 
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0x00, 0x00, 0x00, 0x00, 0x00, 0x00, 0x00, 0x00, 0x00, 0x00, 0x00, 0x00,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 0x00, 
};

const unsigned char PROGMEM splash[] =
{
// width, height,
//128, 64,
0x00, 0x00, 0x00, 0x00, 0x00, 0x00, 0x00, 0x00, 0x00, 0x00, 0x00, 0x00,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 0x00, 
0x00, 0x00, 0x00, 0x00, 0x00, 0x00, 0x00, 0x00, 0x00, 0x00, 0x00, 0x00,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 0x00, 
0x00, 0x00, 0x00, 0x00, 0x00, 0x00, 0x00, 0x00, 0x00, 0x00, 0x00, 0x00,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 0x00, 
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0xff, 0xff, 0xff, 0xff, 0xff, 0xff, 0xff, 0xfe, 0xfd, 0xfa, 0xf4, 0xe9,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 0xff, 
};

const unsigned char PROGMEM pressb[] =
{
// width, height,
33, 10,
0x00, 0xf8, 0x08, 0x48, 0x30, 0x00, 0x78, 0x10, 0x08, 0x00, 0x30, 0x48,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 0x00, 
0x00, 0x01, 0x00, 0x00, 0x00, 0x00, 0x00, 0x00, 0x00, 0x00, 0x00, 0x00,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 0x00, 
};

const unsigned char PROGMEM pressbmask[] =
{
// width, height,
//33, 10,
0xf8, 0xfc, 0xfc, 0xfc, 0x78, 0x78, 0xfc, 0x78, 0x1c, 0x38, 0x78, 0xfc,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 0xfc, 
0x01, 0x03, 0x01, 0x00, 0x00, 0x00, 0x00, 0x00, 0x00, 0x00, 0x00, 0x00,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 0x00, 
};

const unsigned char PROGMEM player1[] =
{
// width, height,
17, 15,

//frame 0
0x00, 0x30, 0x4c, 0xe8, 0x30, 0x08, 0xf0, 0x1c, 0x86, 0x1c, 0xf0, 0x08, 0x30, 0xe8, 0x4c, 0x30, 0x00, 
0x00, 0x02, 0x05, 0x00, 0x0a, 0x11, 0x0a, 0x01, 0x01, 0x01, 0x0a, 0x11, 0x0a, 0x00, 0x05, 0x02, 0x00, 

//frame 1
0x00, 0x30, 0x4c, 0xe8, 0x30, 0x08, 0xf0, 0x1c, 0x86, 0x1c, 0xf0, 0x08, 0x30, 0xe8, 0x4c, 0x30, 0x00, 
0x00, 0x02, 0x09, 0x00, 0x02, 0x31, 0x02, 0x01, 0x01, 0x01, 0x02, 0x31, 0x02, 0x00, 0x09, 0x02, 0x00, 
};

const unsigned char PROGMEM player1mask[] =
{
// width, height,
//17, 15,

//frame 0
0x30, 0x7c, 0xfe, 0xfc, 0xf8, 0xfc, 0xfc, 0xfe, 0xff, 0xfe, 0xfc, 0xfc, 0xf8, 0xfc, 0xfe, 0x7c, 0x30, 
0x02, 0x07, 0x0f, 0x0f, 0x1f, 0x3b, 0x1f, 0x0b, 0x03, 0x0b, 0x1f, 0x3b, 0x1f, 0x0f, 0x0f, 0x07, 0x02, 

//frame 1
0x30, 0x7c, 0xfe, 0xfc, 0xf8, 0xfc, 0xfc, 0xfe, 0xff, 0xfe, 0xfc, 0xfc, 0xf8, 0xfc, 0xfe, 0x7c, 0x30, 
0x02, 0x0f, 0x1f, 0x0b, 0x37, 0x7b, 0x37, 0x03, 0x03, 0x03, 0x37, 0x7b, 0x37, 0x0b, 0x1f, 0x0f, 0x02, 

};

const unsigned char PROGMEM fuelgauge[] =
{
// width, height,
7, 45,
0x00, 0xf4, 0x02, 0xaa, 0x02, 0xf4, 0x00, 
0x00, 0xff, 0x00, 0xaa, 0x00, 0xff, 0x00, 
0x00, 0xff, 0x00, 0xaa, 0x00, 0xff, 0x00, 
0x00, 0xff, 0x00, 0xaa, 0x00, 0xff, 0x00, 
0x00, 0xff, 0x00, 0xaa, 0x00, 0xff, 0x00, 
0x00, 0x07, 0x08, 0x0a, 0x08, 0x07, 0x00, 
};

const unsigned char PROGMEM fuelgaugemask[] =
{
// width, height,
//7, 45,
0xfc, 0xfe, 0xff, 0xff, 0xff, 0xfe, 0xfc, 
0xff, 0xff, 0xff, 0xff, 0xff, 0xff, 0xff, 
0xff, 0xff, 0xff, 0xff, 0xff, 0xff, 0xff, 
0xff, 0xff, 0xff, 0xff, 0xff, 0xff, 0xff, 
0xff, 0xff, 0xff, 0xff, 0xff, 0xff, 0xff, 
0x07, 0x0f, 0x1f, 0x1f, 0x1f, 0x0f, 0x07, 
};

const unsigned char PROGMEM enemy1[] =
{
// width, height,
15, 30,

//frame 0
0x00, 0x40, 0x00, 0xe0, 0x00, 0x44, 0x00, 0xfe, 0x00, 0x44, 0x00, 0xe0, 0x00, 0x40, 0x00, 
0x00, 0xfa, 0x00, 0xff, 0x00, 0x52, 0x00, 0x7f, 0x00, 0x52, 0x00, 0xff, 0x00, 0xfa, 0x00, 
0x00, 0xc1, 0x78, 0xee, 0x84, 0xd4, 0x6e, 0x3f, 0x6e, 0xd4, 0x84, 0xee, 0x78, 0xc1, 0x00, 
0x00, 0x03, 0x03, 0x06, 0x0b, 0x0d, 0x1d, 0x1d, 0x1d, 0x0d, 0x0b, 0x06, 0x03, 0x03, 0x00, 

//frame 1
0x00, 0x20, 0x00, 0xe8, 0x00, 0x20, 0x00, 0xfe, 0x00, 0x20, 0x00, 0xe8, 0x00, 0x20, 0x00, 
0x00, 0xf9, 0x00, 0x6e, 0x00, 0x29, 0x00, 0x7f, 0x00, 0x29, 0x00, 0x6e, 0x00, 0xf9, 0x00, 
0x00, 0xc0, 0x78, 0xee, 0x84, 0xd4, 0x6e, 0x3f, 0x6e, 0xd4, 0x84, 0xee, 0x78, 0xc0, 0x00, 
0x00, 0x03, 0x03, 0x06, 0x0b, 0x09, 0x15, 0x15, 0x15, 0x09, 0x0b, 0x06, 0x03, 0x03, 0x00,
};

const unsigned char PROGMEM enemy1mask[] =
{
// width, height,
//15, 30,

//frame 0
0x40, 0xe0, 0xe0, 0xf0, 0xe4, 0xee, 0xfe, 0xff, 0xfe, 0xee, 0xe4, 0xf0, 0xe0, 0xe0, 0x40, 
0xfa, 0xff, 0xff, 0xff, 0xff, 0xff, 0x7f, 0xff, 0x7f, 0xff, 0xff, 0xff, 0xff, 0xff, 0xfa, 
0xc1, 0xff, 0xff, 0xff, 0xfe, 0xfe, 0xff, 0xff, 0xff, 0xfe, 0xfe, 0xff, 0xff, 0xff, 0xc1, 
0x03, 0x07, 0x07, 0x0f, 0x1f, 0x1f, 0x3f, 0x3f, 0x3f, 0x1f, 0x1f, 0x0f, 0x07, 0x07, 0x03,

//frame 1
0x20, 0xf0, 0xe8, 0xfc, 0x28, 0xf0, 0xfe, 0xff, 0xfe, 0xf0, 0x28, 0xfc, 0x28, 0xf0, 0x20, 
0xf9, 0xff, 0xf9, 0x6e, 0x29, 0x7f, 0xff, 0xff, 0xff, 0x7f, 0x29, 0x6e, 0xf9, 0xff, 0xf9, 
0xc0, 0xf9, 0xfe, 0xff, 0xfe, 0xfe, 0xff, 0xff, 0xff, 0xfe, 0xfe, 0xff, 0xfe, 0xf9, 0xc0, 
0x03, 0x07, 0x07, 0x0f, 0x1f, 0x1f, 0x3f, 0x3f, 0x3f, 0x1f, 0x1f, 0x0f, 0x07, 0x07, 0x03, 
};

const unsigned char PROGMEM heart[] =
{
// width, height,
16, 14,

//frame 0
0x00, 0x70, 0x88, 0x74, 0xda, 0xaa, 0x4a, 0x94, 0x14, 0x0a, 0x0a, 0x8a, 0x74, 0x88, 0x70, 0x00, 
0x00, 0x00, 0x00, 0x01, 0x02, 0x05, 0x0b, 0x16, 0x15, 0x0a, 0x05, 0x02, 0x01, 0x00, 0x00, 0x00, 

//frame 1
0x00, 0x00, 0x00, 0x00, 0xf8, 0x04, 0x02, 0x04, 0x04, 0xfa, 0x04, 0xf8, 0x00, 0x00, 0x00, 0x00, 
0x00, 0x00, 0x00, 0x00, 0x01, 0x06, 0x0c, 0x18, 0x14, 0x0b, 0x04, 0x03, 0x00, 0x00, 0x00, 0x00, 

//frame 2
0x00, 0x00, 0x00, 0x00, 0x00, 0x00, 0xfc, 0xc2, 0xc2, 0xfc, 0x00, 0x00, 0x00, 0x00, 0x00, 0x00, 
0x00, 0x00, 0x00, 0x00, 0x00, 0x00, 0x0f, 0x1a, 0x1a, 0x0f, 0x00, 0x00, 0x00, 0x00, 0x00, 0x00, 

//frame 3
0x00, 0x00, 0x00, 0x00, 0xf8, 0x04, 0xfa, 0x04, 0x04, 0x02, 0x04, 0xf8, 0x00, 0x00, 0x00, 0x00, 
0x00, 0x00, 0x00, 0x00, 0x03, 0x04, 0x0b, 0x14, 0x18, 0x0c, 0x06, 0x01, 0x00, 0x00, 0x00, 0x00, 

//frame 4
0x00, 0x70, 0x88, 0x74, 0xda, 0xaa, 0x4a, 0x94, 0x14, 0x0a, 0x0a, 0x8a, 0x74, 0x88, 0x70, 0x00, 
0x00, 0x00, 0x00, 0x01, 0x02, 0x05, 0x0b, 0x16, 0x15, 0x0a, 0x05, 0x02, 0x01, 0x00, 0x00, 0x00,
};

const unsigned char PROGMEM hearthurt[] =
{
// width, height,
16, 14,

// frame 0
0x00, 0x70, 0xe8, 0xb4, 0xba, 0xee, 0x06, 0xfc, 0x0c, 0xf6, 0x0e, 0xfa, 0x74, 0x88, 0x70, 0x00, 
0x00, 0x00, 0x00, 0x01, 0x02, 0x07, 0x0c, 0x17, 0x16, 0x0d, 0x06, 0x03, 0x01, 0x00, 0x00, 0x00, 

// frame 1
0x00, 0x70, 0xe8, 0xb4, 0xba, 0xee, 0x06, 0xfc, 0x0c, 0xf6, 0x0e, 0xfa, 0x74, 0x88, 0x70, 0x00, 
0x00, 0x00, 0x00, 0x01, 0x02, 0x07, 0x0c, 0x17, 0x16, 0x0d, 0x06, 0x03, 0x01, 0x00, 0x00, 0x00, 

// frame 2
0x00, 0x70, 0xe8, 0xb4, 0xba, 0xee, 0x06, 0xfc, 0x0c, 0xf6, 0x0e, 0xfa, 0x74, 0x88, 0x70, 0x00, 
0x00, 0x00, 0x00, 0x01, 0x02, 0x07, 0x0c, 0x17, 0x16, 0x0d, 0x06, 0x03, 0x01, 0x00, 0x00, 0x00, 

// frame 3
0x00, 0x70, 0xe8, 0xb4, 0xba, 0xee, 0x06, 0xfc, 0x0c, 0xf6, 0x0e, 0xfa, 0x74, 0x88, 0x70, 0x00, 
0x00, 0x00, 0x00, 0x01, 0x02, 0x07, 0x0c, 0x17, 0x16, 0x0d, 0x06, 0x03, 0x01, 0x00, 0x00, 0x00, 
};

const unsigned char PROGMEM hearthurtmask[] =
{
// width, height,
// 16, 14,

// frame 0
0x70, 0xf8, 0xfc, 0xfe, 0xff, 0xff, 0xff, 0xfe, 0xfe, 0xff, 0xff, 0xff, 0xfe, 0xfc, 0xf8, 0x70, 
0x00, 0x00, 0x01, 0x03, 0x07, 0x0f, 0x1f, 0x3f, 0x3f, 0x1f, 0x0f, 0x07, 0x03, 0x01, 0x00, 0x00,  

// frame 1
0x70, 0xf8, 0xfc, 0xfe, 0xff, 0xff, 0xff, 0xfe, 0xfe, 0xff, 0xff, 0xff, 0xfe, 0xfc, 0xf8, 0x70, 
0x00, 0x00, 0x01, 0x03, 0x07, 0x0f, 0x1f, 0x3f, 0x3f, 0x1f, 0x0f, 0x07, 0x03, 0x01, 0x00, 0x00,

// frame 2
0x70, 0xf8, 0xfc, 0xfe, 0xff, 0xff, 0xff, 0xfe, 0xfe, 0xff, 0xff, 0xff, 0xfe, 0xfc, 0xf8, 0x70, 
0x00, 0x00, 0x01, 0x03, 0x07, 0x0f, 0x1f, 0x3f, 0x3f, 0x1f, 0x0f, 0x07, 0x03, 0x01, 0x00, 0x00,

// frame 3
0x70, 0xf8, 0xfc, 0xfe, 0xff, 0xff, 0xff, 0xfe, 0xfe, 0xff, 0xff, 0xff, 0xfe, 0xfc, 0xf8, 0x70, 
0x00, 0x00, 0x01, 0x03, 0x07, 0x0f, 0x1f, 0x3f, 0x3f, 0x1f, 0x0f, 0x07, 0x03, 0x01, 0x00, 0x00,
};

const unsigned char PROGMEM heartmask[] =
{
// width, height,
//16, 14,

//frame 0
0x70, 0xf8, 0xfc, 0xfe, 0xff, 0xff, 0xff, 0xfe, 0xfe, 0xff, 0xff, 0xff, 0xfe, 0xfc, 0xf8, 0x70, 
0x00, 0x00, 0x01, 0x03, 0x07, 0x0f, 0x1f, 0x3f, 0x3f, 0x1f, 0x0f, 0x07, 0x03, 0x01, 0x00, 0x00, 

//frame 1
0x00, 0x00, 0x00, 0xf8, 0xfc, 0xfe, 0xff, 0xfe, 0xfe, 0xff, 0xfe, 0xfc, 0xf8, 0x00, 0x00, 0x00, 
0x00, 0x00, 0x00, 0x01, 0x07, 0x0f, 0x1f, 0x3f, 0x3f, 0x1f, 0x0f, 0x07, 0x03, 0x00, 0x00, 0x00, 

//frame 2
0x00, 0x00, 0x00, 0x00, 0x00, 0xfc, 0xfe, 0xff, 0xff, 0xfe, 0xfc, 0x00, 0x00, 0x00, 0x00, 0x00, 
0x00, 0x00, 0x00, 0x00, 0x00, 0x0f, 0x1f, 0x3f, 0x3f, 0x1f, 0x0f, 0x00, 0x00, 0x00, 0x00, 0x00, 

//frame 3
0x00, 0x00, 0x00, 0xf8, 0xfc, 0xfe, 0xff, 0xfe, 0xfe, 0xff, 0xfe, 0xfc, 0xf8, 0x00, 0x00, 0x00, 
0x00, 0x00, 0x00, 0x03, 0x07, 0x0f, 0x1f, 0x3f, 0x3f, 0x1f, 0x0f, 0x07, 0x01, 0x00, 0x00, 0x00, 

//frame 4
0x70, 0xf8, 0xfc, 0xfe, 0xff, 0xff, 0xff, 0xfe, 0xfe, 0xff, 0xff, 0xff, 0xfe, 0xfc, 0xf8, 0x70, 
0x00, 0x00, 0x01, 0x03, 0x07, 0x0f, 0x1f, 0x3f, 0x3f, 0x1f, 0x0f, 0x07, 0x03, 0x01, 0x00, 0x00,
};

const unsigned char PROGMEM cloudborderl[] =
{
// width, height,
25, 64,
0xff, 0xff, 0xff, 0xff, 0xff, 0xff, 0xff, 0xff, 0xff, 0xff, 0xff, 0xff, 0xfe, 0xfe, 0xfd, 0xfd, 0xfb, 0xe1, 0x80, 0x00, 0x00, 0x00, 0x00, 0x00, 0x00, 
0xff, 0xff, 0xff, 0xff, 0xff, 0xff, 0xff, 0xff, 0xff, 0xff, 0xff, 0xff, 0xff, 0xff, 0xff, 0xff, 0xbf, 0xcf, 0xc7, 0x80, 0x00, 0x00, 0x00, 0x00, 0x00, 
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0xff, 0xff, 0xff, 0xff, 0xff, 0xff, 0xff, 0xff, 0xff, 0xff, 0xff, 0xff, 0x7f, 0x7f, 0xbf, 0xbf, 0xdf, 0xe7, 0x01, 0x00, 0x00, 0x00, 0x00, 0x00, 0x00, 
};

const unsigned char PROGMEM cloudbackdrop[] =
{
// width, height,
128, 64,
0x55, 0xaa, 0x55, 0xaa, 0x55, 0xaa, 0x55, 0xaa, 0x55, 0xaa, 0x55, 0xaa,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 0xaa, 
0x55, 0xaa, 0x55, 0xaa, 0x55, 0xaa, 0x55, 0xaa, 0x55, 0xaa, 0x55, 0xaa,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 0xaa, 
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0x55, 0xaa, 0x55, 0xaa, 0x55, 0xaa, 0x55, 0xaa, 0x55, 0xaa, 0x55, 0xaa,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 0xaa, 
};

const unsigned char PROGMEM cloudbackdrop2[] =
{
// width, height,
128, 64,
0x55, 0xaa, 0x55, 0xaa, 0x55, 0xaa, 0x55, 0xaa, 0x55, 0xaa, 0x55, 0xaa,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 0xaa, 
0x55, 0xaa, 0x55, 0xaa, 0x55, 0xaa, 0x55, 0xaa, 0x55, 0xaa, 0x55, 0xaa,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 0xaa, 
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0x55, 0xaa, 0x55, 0xaa, 0x55, 0xaa, 0x55, 0xaa, 0x55, 0xaa, 0x55, 0xaa,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 0xaa, 
};

const unsigned char PROGMEM cloudborderlmask[] =
{
// width, height,
//25, 64,
0xff, 0xff, 0xff, 0xff, 0xff, 0xff, 0xff, 0xff, 0xff, 0xff, 0xff, 0xff, 0xff, 0xff, 0xff, 0xff, 0xff, 0xfb, 0xe1, 0x80, 0x00, 0x00, 0x00, 0x00, 0x00, 
0xff, 0xff, 0xff, 0xff, 0xff, 0xff, 0xff, 0xff, 0xff, 0xff, 0xff, 0xff, 0xff, 0xff, 0xff, 0xff, 0xff, 0xff, 0xef, 0xc7, 0x80, 0x00, 0x00, 0x00, 0x00, 
0xff, 0xff, 0xff, 0xff, 0xff, 0xff, 0xff, 0xff, 0xff, 0xff, 0xff, 0xff, 0xff, 0xff, 0xff, 0xff, 0xff, 0xff, 0xff, 0xdf, 0x8f, 0x07, 0x00, 0x00, 0x00, 
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0xff, 0xff, 0xff, 0xff, 0xff, 0xff, 0xff, 0xff, 0xff, 0xff, 0xff, 0xff, 0xff, 0xff, 0xff, 0xff, 0xff, 0xff, 0xe7, 0x01, 0x00, 0x00, 0x00, 0x00, 0x00, 
};

const unsigned char PROGMEM cloudborderr[] =
{
25, 64,
0x00, 0x00, 0x00, 0x00, 0x00, 0x00, 0x80, 0xe7, 0xfb, 0xfd, 0xfd, 0xfe, 0xfe, 0xff, 0xff, 0xff, 0xff, 0xff, 0xff, 0xff, 0xff, 0xff, 0xff, 0xff, 0xff, 
0x00, 0x00, 0x80, 0xc0, 0xe0, 0xf7, 0xfb, 0xfb, 0xff, 0xff, 0xff, 0xff, 0xff, 0xff, 0xff, 0xff, 0xff, 0xff, 0xff, 0xff, 0xff, 0xff, 0xff, 0xff, 0xff, 
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0x00, 0x00, 0x00, 0x00, 0x00, 0x00, 0x01, 0x87, 0xdf, 0xbf, 0xbf, 0x7f, 0x7f, 0xff, 0xff, 0xff, 0xff, 0xff, 0xff, 0xff, 0xff, 0xff, 0xff, 0xff, 0xff, 
};

const unsigned char PROGMEM cloudborderrmask[] =
{
//25, 64,
0x00, 0x00, 0x00, 0x00, 0x00, 0x80, 0xe7, 0xff, 0xff, 0xff, 0xff, 0xff, 0xff, 0xff, 0xff, 0xff, 0xff, 0xff, 0xff, 0xff, 0xff, 0xff, 0xff, 0xff, 0xff, 
0x00, 0x80, 0xc0, 0xe0, 0xf7, 0xff, 0xff, 0xff, 0xff, 0xff, 0xff, 0xff, 0xff, 0xff, 0xff, 0xff, 0xff, 0xff, 0xff, 0xff, 0xff, 0xff, 0xff, 0xff, 0xff, 
0x00, 0x07, 0x0f, 0x1f, 0x3f, 0x7f, 0xff, 0xff, 0xff, 0xff, 0xff, 0xff, 0xff, 0xff, 0xff, 0xff, 0xff, 0xff, 0xff, 0xff, 0xff, 0xff, 0xff, 0xff, 0xff, 
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0x00, 0x00, 0x00, 0x00, 0x00, 0x01, 0x87, 0xdf, 0xff, 0xff, 0xff, 0xff, 0xff, 0xff, 0xff, 0xff, 0xff, 0xff, 0xff, 0xff, 0xff, 0xff, 0xff, 0xff, 0xff, 
};

const unsigned char PROGMEM explosion[] =
{
// width, height,
11, 11,

// frame 0
0x00, 0x00, 0x00, 0x00, 0x20, 0x70, 0x20, 0x00, 0x00, 0x00, 0x00, 
0x00, 0x00, 0x00, 0x00, 0x00, 0x00, 0x00, 0x00, 0x00, 0x00, 0x00, 

// frame 1  
0x00, 0x00, 0x00, 0xa8, 0x20, 0xd8, 0x20, 0xa8, 0x00, 0x00, 0x00, 
0x00, 0x00, 0x00, 0x00, 0x00, 0x00, 0x00, 0x00, 0x00, 0x00, 0x00, 

// frame 2
0x00, 0x00, 0x24, 0x20, 0x00, 0x8c, 0x00, 0x20, 0x24, 0x00, 0x00, 
0x00, 0x00, 0x01, 0x00, 0x00, 0x01, 0x00, 0x00, 0x01, 0x00, 0x00,  

// frame 3
0x00, 0x22, 0x20, 0x00, 0x00, 0x02, 0x00, 0x00, 0x20, 0x22, 0x00, 
0x00, 0x02, 0x00, 0x00, 0x00, 0x02, 0x00, 0x00, 0x00, 0x02, 0x00,  

// frame 4
0x00, 0x22, 0x20, 0x00, 0x00, 0x02, 0x00, 0x00, 0x20, 0x22, 0x00, 
0x00, 0x02, 0x00, 0x00, 0x00, 0x02, 0x00, 0x00, 0x00, 0x02, 0x00, 
};

const unsigned char PROGMEM explosionmask[] =
{
// width, height,
//11, 11,

// frame 0
0x00, 0x00, 0x00, 0x20, 0x70, 0xf8, 0x70, 0x20, 0x00, 0x00, 0x00, 
0x00, 0x00, 0x00, 0x00, 0x00, 0x00, 0x00, 0x00, 0x00, 0x00, 0x00,  

// frame 1
0x00, 0x00, 0xa8, 0xfc, 0xf8, 0xfc, 0xf8, 0xfc, 0xa8, 0x00, 0x00, 
0x00, 0x00, 0x00, 0x01, 0x00, 0x01, 0x00, 0x01, 0x00, 0x00, 0x00, 

// frame 2
0x00, 0x24, 0xfe, 0x74, 0xac, 0xde, 0xac, 0x74, 0xfe, 0x24, 0x00, 
0x00, 0x01, 0x03, 0x01, 0x01, 0x03, 0x01, 0x01, 0x03, 0x01, 0x00, 

// frame 3
0x22, 0x77, 0x72, 0x20, 0x02, 0x07, 0x02, 0x20, 0x72, 0x77, 0x22, 
0x02, 0x07, 0x02, 0x00, 0x02, 0x07, 0x02, 0x00, 0x02, 0x07, 0x02, 

// frame 4
0x22, 0x77, 0x72, 0x20, 0x02, 0x07, 0x02, 0x20, 0x72, 0x77, 0x22, 
0x02, 0x07, 0x02, 0x00, 0x02, 0x07, 0x02, 0x00, 0x02, 0x07, 0x02, 
};

const unsigned char PROGMEM lowfuel[] =
{
// width, height,
28, 7,

// frame 0
0x00, 0x2e, 0x00, 0x2e, 0x00, 0x00, 0x00, 0x3e, 0x0a, 0x02, 0x00, 0x3e, 0x20, 0x3e, 0x00, 0x3e, 0x2a, 0x00, 0x3e, 0x20, 0x20, 0x00, 0x00, 0x00, 0x2e, 0x00, 0x2e, 0x00, 
};

const unsigned char PROGMEM lowfuelmask[] =
{
// width, height,
//28, 7,

// frame 0
0x2e, 0x7f, 0x2e, 0x7f, 0x2e, 0x00, 0x3e, 0x7f, 0x3f, 0x0f, 0x3e, 0x7f, 0x7e, 0x7f, 0x3e, 0x7f, 0x7f, 0x2a, 0x7f, 0x7e, 0x70, 0x20, 0x00, 0x2e, 0x7f, 0x2e, 0x7f, 0x2e, 
};

const unsigned char PROGMEM fuelpowerup[] =
{
// width, height,
20, 13,
// frame 0
0x20, 0x50, 0xa8, 0x54, 0xba, 0x1d, 0xfa, 0x05, 0xf5, 0x55, 0x55, 0x15, 0x05, 0xfa, 0x1d, 0xba, 0x54, 0xa8, 0x50, 0x20, 
0x00, 0x00, 0x00, 0x00, 0x07, 0x08, 0x17, 0x14, 0x15, 0x14, 0x14, 0x14, 0x14, 0x17, 0x08, 0x07, 0x00, 0x00, 0x00, 0x00, 

// frame 1
0x0c, 0x12, 0x2a, 0x2d, 0xdd, 0x1d, 0xfa, 0x05, 0xf5, 0x55, 0x55, 0x15, 0x05, 0xfa, 0x1d, 0xdd, 0x2d, 0x2a, 0x12, 0x0c, 
0x00, 0x00, 0x00, 0x00, 0x07, 0x08, 0x17, 0x14, 0x15, 0x14, 0x14, 0x14, 0x14, 0x17, 0x08, 0x07, 0x00, 0x00, 0x00, 0x00, 
};

const unsigned char PROGMEM fuelpowerupmask[] =
{
// width, height,
//20, 13,

// frame 0
0x20, 0x70, 0xf8, 0x7c, 0xfe, 0xff, 0xfe, 0xff, 0xff, 0xff, 0xff, 0xff, 0xff, 0xfe, 0xff, 0xfe, 0x7c, 0xf8, 0x70, 0x20, 
0x00, 0x00, 0x00, 0x00, 0x07, 0x0f, 0x1f, 0x1f, 0x1f, 0x1f, 0x1f, 0x1f, 0x1f, 0x1f, 0x0f, 0x07, 0x00, 0x00, 0x00, 0x00, 

// frame 1
0x0c, 0x1e, 0x3e, 0x3f, 0xff, 0xff, 0xfe, 0xff, 0xff, 0xff, 0xff, 0xff, 0xff, 0xfe, 0xff, 0xff, 0x3f, 0x3e, 0x1e, 0x0c, 
0x00, 0x00, 0x00, 0x00, 0x07, 0x0f, 0x1f, 0x1f, 0x1f, 0x1f, 0x1f, 0x1f, 0x1f, 0x1f, 0x0f, 0x07, 0x00, 0x00, 0x00, 0x00, 
};

void initEEPROM() {
  char c1 = EEPROM.read(EEPROM_START_C1);
  char c2 = EEPROM.read(EEPROM_START_C2);
  
  if (c1 != 'L' || c2 != 'Z') {
    highScore = 0;
    EEPROM.update(EEPROM_START_C1, 'L');
    EEPROM.update(EEPROM_START_C2, 'Z');
    EEPROM.update(EEPROM_SCORE, highScore);
  }
  else {
    EEPROM.get(EEPROM_SCORE, highScore);
  }
}

// Resets the fade out effect
void resetFade()
{
  fadeWidth = 0;
}

// Resets the fade in effect
void resetFadeIn()
{
  fadeWidth = WIDTH;
}

// fade in function
bool fadeIn()
{
  for(uint8_t i = 0; i < (HEIGHT / 2); ++i)
  {
    arduboy.drawFastHLine(0, (i * 2), fadeWidth, BLACK);
    arduboy.drawFastHLine((WIDTH - fadeWidth), (i * 2) + 1, fadeWidth, BLACK);
  }

  // If fade isn't complete, decrease the counter
  if(fadeWidth > 0)
  {
    fadeWidth = fadeWidth - 4;
    return false;
  }
  else
    return true;
}

// fade out function
bool fadeOut()
{
  for(uint8_t i = 0; i < (HEIGHT / 2); ++i)
  {
    arduboy.drawFastHLine(0, (i * 2), fadeWidth, BLACK);
    arduboy.drawFastHLine((WIDTH - fadeWidth), (i * 2) + 1, fadeWidth, BLACK);
  }
  // If fade isn't complete, increase the counter
  if(fadeWidth < WIDTH)
  {
    ++fadeWidth;
    return false;
  }
  else
    return true;
  
}

void setup() {
  // things that needs to be ran once
  arduboy.boot();
  arduboy.display();
  arduboy.flashlight();
  arduboy.systemButtons();
  arduboy.audio.begin();
  // no call to bootLogo
  arduboy.clear();
  initEEPROM();
  
  // limits the frames per second
  arduboy.setFrameRate(60);
}

void loop() {
    // Wait for the next frame
   if (!(arduboy.nextFrame())) return;
  
  arduboy.pollButtons();
  arduboy.clear();

  if (state == 0)  { vsboot(); }
  else if (state == 1)  { doSplash(); }
  else if (state == 2)  { gameplay(); }
  else if (state == 3)  { gameover(); }
  else if (state == 4)  { pause(); }
  
  arduboy.display();
}

void handleCollisions()
{
  Rect playerRect = { player.x + 6, player.y + 4, 5, 5 };
  Rect enemy1Rect = { enemy1x + 1, enemy1y + 20, 13, 13 };
  Rect enemy2Rect = { enemy2x + 1, enemy2y + 20, 13, 13 };
  Rect heartRect = { heartx + 1, hearty + 1, 15, 13 };

// collision with a heart  
  if(arduboy.collide(playerRect, heartRect)) {
  score = score + 5;
  ++heartcounter;
  sound.tone(NOTE_E3,80, NOTE_E4,80, NOTE_E5,80);
  hearty = -14;
  heartx = random(26,87);
  // check if you gain a life
    if(heartcounter >= 15) {
    ++shield; oneup(); heartcounter = 0;
    }
  }

// collision with enemy 1
  if(arduboy.collide(playerRect, enemy1Rect)) {
  --shield;
  youarehit();
  enemy1y = -14;
  enemy1x = random(26,87);
  }
  
// collision with enemy 2  
  if(arduboy.collide(playerRect, enemy2Rect)) {
  --shield;
  youarehit();
  enemy2y = -28;
  enemy2x = random(26,87);
  }

// collision with fuel
  Rect fuelpowRect = { fuelpower.x + 3, fuelpower.y + 3, 12, 12 };  

  if(arduboy.collide(playerRect, fuelpowRect))
  {
    onCollideWithPowerup();
  }
  
// collisions with the laser  
  if(arduboy.justPressed(A_BUTTON)) {
        sound.tone(NOTE_C5,50, NOTE_C3,100, NOTE_C2,200);
        arduboy.drawLine(player.x + 6, player.y - 1, player.x + 6, 10, WHITE);
        arduboy.drawLine(player.x + 8, player.y - 1, player.x + 8, 10, WHITE);
        arduboy.drawLine(player.x + 10, player.y - 1, player.x + 10, 10, WHITE);
        Rect laserRect = { player.x + 8, player.y - 64, 2, 64 };
          if(arduboy.collide(laserRect, enemy1Rect)) {
          score = score + 10;
          fuelcount = (fuelcount > 1) ? fuelcount - 1 : 0;
          sound.tone(NOTE_C3,100, NOTE_C2,100, NOTE_C1,100);
          expl1.x = enemy1x;
          expl1.y = enemy1y + 12;
          hit = true;
          enemy1y = -14;
          enemy1x = random(26,87);
          }
            if(arduboy.collide(laserRect, enemy2Rect)) {
            score = score + 10;
            fuelcount = (fuelcount > 1) ? fuelcount - 1 : 0;
            sound.tone(NOTE_C3,100, NOTE_C2,100, NOTE_C1,100);
            expl1.x = enemy2x + 2;
            expl1.y = enemy2y + 12;
            hit = true;
            enemy2y = -14;
            enemy2x = random(26,87);
            }
              if(arduboy.collide(laserRect, heartRect)) {
              //check if score would be lower then 10, if not -10 pts
              score = (score > 10) ? score - 10 : 0;
              sound.tone(NOTE_C4,100, NOTE_C4,100, NOTE_C4,100);
              heartminus.x = heartx;
              heartminus.y = hearty;
              hearthit = true;
              hearty = -14;
              heartx = random(26,87);
              }
    }
}

void onCollideWithPowerup()
{
  fuelcount = (fuelcount > 12) ? fuelcount - 12 : 0;
  gotpowerup = true;
  
  resetPowerup();
  
  sound.tone(NOTE_E6,100, NOTE_E7,100, NOTE_E8,100);
  
}

void resetPowerup()
{
  // Power up spawn code goes here
  fuelpower.x = random(26, 87);
  fuelpower.y = -28;
  
  // New power up at random interval between 30 and 60 seconds
  powerUpCounter = random(20, 30);
}

void drawPowerup()
{
  Sprites::drawExternalMask(fuelpower.x, fuelpower.y, fuelpowerup, fuelpowerupmask, powerup1Frame, powerup1Frame);
}

void updatePowerup()
{
  // Move powerup one pixel every 1/4 seconds
  if(arduboy.everyXFrames(FPS / 60))
  {
    if(fuelpower.y <= HEIGHT)
    {
      // Move ++fuelpower.y; from where it currently is to here
      // This will prevent it moving after it goes offscreen
      ++fuelpower.y;
    }
  }

  if(arduboy.everyXFrames(FPS))
  {
    if(fuelpower.y > HEIGHT)
    {
      if(powerUpCounter > 0)
        --powerUpCounter;
      else
        resetPowerup();
    }
  }

  if(arduboy.everyXFrames(15)) // when running at 60fps
  {
    ++powerup1Frame; // Add 1
    powerup1Frame %= 2; // resets frame to 0 if greater then 4
  }
}

void vsboot() {
  // Vsoft logo display
  arduboy.drawBitmap(0, 0, bootlogo, 128, 64, WHITE);
  if(fadeOut())
  {
    resetFade();
    resetFadeIn();
    state = 1;
  }
}

  // scrolling background1 function
void scrollingbackground() {
  arduboy.drawBitmap(backdropx, backdropy, cloudbackdrop, 128, 64, WHITE);
  arduboy.drawBitmap(backdropx, backdropy - 64, cloudbackdrop, 128, 64, WHITE);
  sprite.drawExternalMask(cloudl.x, cloudl.y, cloudborderl, cloudborderlmask, 0, 0);
  sprite.drawExternalMask(cloudr.x, cloudr.y, cloudborderr, cloudborderrmask, 0, 0);
  sprite.drawExternalMask(cloudl.x, cloudl.y - 64, cloudborderl, cloudborderlmask, 0, 0);
  sprite.drawExternalMask(cloudr.x, cloudr.y - 64, cloudborderr, cloudborderrmask, 0, 0);
  sprite.drawExternalMask(cloudl.x, cloudl.y + 64, cloudborderl, cloudborderlmask, 0, 0);
  sprite.drawExternalMask(cloudr.x, cloudr.y + 64, cloudborderr, cloudborderrmask, 0, 0);
  
  // background scrolling loop
  ++backdropy;
  if( backdropy > 64 ) {
  backdropy = 0;
  }
  cloudl.y = cloudl.y +2;
  cloudr.y = cloudr.y +2;
  if( cloudl.y > 64 ) {
  cloudl.y = 0;
  }
  if( cloudr.y > 64 ) {
  cloudr.y = 0;
  }
}

void scrollingbackground2() {
  arduboy.drawBitmap(backdropx, backdropy, cloudbackdrop2, 128, 64, WHITE);
  arduboy.drawBitmap(backdropx, backdropy - 64, cloudbackdrop2, 128, 64, WHITE);
  sprite.drawExternalMask(cloudl.x, cloudl.y, cloudborderl, cloudborderlmask, 0, 0);
  sprite.drawExternalMask(cloudr.x, cloudr.y, cloudborderr, cloudborderrmask, 0, 0);
  sprite.drawExternalMask(cloudl.x, cloudl.y - 64, cloudborderl, cloudborderlmask, 0, 0);
  sprite.drawExternalMask(cloudr.x, cloudr.y - 64, cloudborderr, cloudborderrmask, 0, 0);
  sprite.drawExternalMask(cloudl.x, cloudl.y + 64, cloudborderl, cloudborderlmask, 0, 0);
  sprite.drawExternalMask(cloudr.x, cloudr.y + 64, cloudborderr, cloudborderrmask, 0, 0);
  
  // background scrolling loop
  ++backdropy;
  if( backdropy > 64 ) {
  backdropy = 0;
  }
  cloudl.y = cloudl.y +2;
  cloudr.y = cloudr.y +2;
  if( cloudl.y > 64 ) {
  cloudl.y = 0;
  }
  if( cloudr.y > 64 ) {
  cloudr.y = 0;
  }
}

  // Pause state
void pause() {
  scrollingbackground2();
  arduboy.fillRect(0, 24, 128, 20, BLACK);
  arduboy.drawLine(0, 25, 128, 25, WHITE);
  arduboy.drawLine(0, 42, 128, 42, WHITE);
  arduboy.drawLine(0, 45, 128, 45, BLACK);
  arduboy.drawLine(0, 47, 128, 47, BLACK);
  arduboy.setCursor(49, 31);
  arduboy.print(F("PAUSE"));
  if(arduboy.everyXFrames(15)) // when running at 60fps
  {
  ++heartFrame; // Add 1
  if(heartFrame > 4) { heartFrame = 0; } // resets frame to 0 if greater then 4
  }
  Sprites::drawExternalMask(28, 27, heart, heartmask, heartFrame, heartFrame);
  Sprites::drawExternalMask(82, 27, heart, heartmask, heartFrame, heartFrame);
  arduboy.setCursor(15, 37);
  // If 'B' button is pressed move back to gameplay
  if (arduboy.justPressed(B_BUTTON))  { state = 2; }

}

  // Splashscreen state
void doSplash() {
  // Reset highScore value option
  if(!primed) {
  if (arduboy.justPressed(B_BUTTON))
  {
    primed = true;
  }
  }
  else {
  if (arduboy.justPressed(DOWN_BUTTON))
  {
    highScore = 0;
    EEPROM.put(EEPROM_SCORE, highScore);
    primed = false; sound.tone(NOTE_E5,50, NOTE_E6,50, NOTE_E7,50);
  }
  else if (arduboy.justPressed(B_BUTTON)) {
    primed = false;
  }
  // Display a warning
  // Might want to change the position
  arduboy.setCursor(16, 1);
  arduboy.print(F("DOWN:DEL."));
  arduboy.setCursor(66, 1);
  arduboy.print(F("B:CANCEL"));
  }
  
  if(arduboy.everyXFrames(15)) // when running at 60fps
  {
  ++heartFrame; // Add 1
  if(heartFrame > 4) { heartFrame = 0; } // resets frame to 0 if greater then 4
  }

  // 2 hearts for the Splashscreen
  Sprites::drawExternalMask(23, 31, heart, heartmask, heartFrame, heartFrame);
  Sprites::drawExternalMask(89, 31, heart, heartmask, heartFrame, heartFrame);
  arduboy.drawBitmap(0, 0, splash, 128, 64, WHITE);
  fadeIn();

  // If 'A' button is pressed move to gameplay
  if (arduboy.justPressed(A_BUTTON))  {
    arduboy.initRandomSeed();
    score = 0;
    shield = 3;
    fuelcount = 0;
    state = 2; 
    resetFadeIn();
  }

}

  // Gameover state
  void gameover() {
  
  // Only need 5 for a uint16_t
  uint8_t digits[5];
  
  if (score > highScore) {
    highScore = score;
    EEPROM.put(EEPROM_SCORE, highScore);
  }
  scrollingbackground();
  arduboy.fillRect(0, 16, 128, 31, BLACK);
  arduboy.drawLine(0, 17, 128, 17, WHITE);
  arduboy.drawLine(0, 45, 128, 45, WHITE);
  arduboy.drawLine(0, 48, 128, 48, BLACK);
  arduboy.drawLine(0, 50, 128, 50, BLACK);
  
  arduboy.setCursor(37, 5);
  arduboy.print(F("GAME OVER"));
  
  arduboy.setCursor(30, 23);
  arduboy.print(F("SCORE:"));
  arduboy.setCursor(65, 23);
  extractDigits(digits, score);
  for(uint8_t i = 5; i > 0; --i)
  arduboy.print(digits[i - 1]);
  
  arduboy.setCursor(15, 33);
  arduboy.print(F("HIGH SCORE:"));
  arduboy.setCursor(81, 33);
  extractDigits(digits, highScore);
  for(uint8_t i = 5; i > 0; --i)
  arduboy.print(digits[i - 1]);
  
  sprite.drawExternalMask(46, 52, pressb, pressbmask, 0, 0);

  // If 'A' button is pressed move to splash
  if (arduboy.justPressed(B_BUTTON))  {
    fueltimer = 0;
    state = 1;
    score = 0;
    enemy1y = -28;
    enemy2y = -28;
    fuelpower.y = -28;
    hearty = -28;
    heartx = random(26,87);
  }
}

void explosions()
{
  if(hit)
  {
    if(arduboy.everyXFrames(5)) // when running at 60fps
    {
      ++explosionFrame;
      if(explosionFrame > 3)
      {
        // resets frame to 0 and turn off explosion
        explosionFrame = 0;
        hit = false;
      }
    }
    Sprites::drawExternalMask(expl1.x, expl1.y, explosion, explosionmask, explosionFrame, explosionFrame);
    --expl1.y;
  }
}

void heartshot()
{
  if(hearthit)
  {
    if(arduboy.everyXFrames(5)) // when running at 60fps
    {
      ++heartminusFrame;
      if(heartminusFrame > 3)
      {
        // resets frame to 0 and turn off explosion
        heartminusFrame = 0;
        hearthit = false;
      }
    }
    Sprites::drawExternalMask(heartminus.x, heartminus.y, hearthurt, hearthurtmask, heartminusFrame, heartminusFrame);
    --heartminus.y;
  }
}

void youarehit() {
sound.tone(NOTE_C4,100, NOTE_C3,100, NOTE_C2,100);
arduboy.invert(true);
arduboy.digitalWriteRGB(RED_LED, RGB_ON);
flashtimer = arduboy.frameCount + 2; // speed to the screen flash when hit
ledTimer = arduboy.frameCount + 30;
  // check is game is over
  if(shield < 0) {
  speed = 1;
  state = 3;
  arduboy.invert(false); // display the screen no inverted
  arduboy.digitalWriteRGB(RED_LED, RGB_OFF); // turn off LEDS
  arduboy.digitalWriteRGB(GREEN_LED, RGB_OFF); // turn off LEDS
  arduboy.digitalWriteRGB(BLUE_LED, RGB_OFF); // turn off LEDS
  }
}

void oneup() {
arduboy.digitalWriteRGB(GREEN_LED, RGB_ON);
sound.tone(NOTE_E6,100, NOTE_E7,100, NOTE_E8,100);
ledTimerg = arduboy.frameCount + 30;
}

void speedupdisplay() {
arduboy.digitalWriteRGB(BLUE_LED, RGB_ON);
ledTimerb = arduboy.frameCount + 30;
sound.tone(NOTE_G4,100, NOTE_E5,100, NOTE_C6,100);
sound.tone(NOTE_C5,100, NOTE_E4,100, NOTE_G3,100);
}

  // gameplay state
void gameplay() {
  
  // Only need 5 for a uint16_t
  uint8_t digits[5];
  
  uint16_t oldScore = score;
  
  if(ledTimer > 0 && arduboy.frameCount >= ledTimer)
  {
  arduboy.digitalWriteRGB(RED_LED, RGB_OFF);
  ledTimer = 0;
  }
    if(ledTimerg > 0 && arduboy.frameCount >= ledTimerg)
    {
    arduboy.digitalWriteRGB(GREEN_LED, RGB_OFF);
    ledTimerg = 0;
    }

    if(ledTimerb > 0 && arduboy.frameCount >= ledTimerb)
    {
    arduboy.digitalWriteRGB(BLUE_LED, RGB_OFF);
    ledTimerb = 0;
    }
        if(flashtimer > 0 && arduboy.frameCount >= flashtimer)
        {
        arduboy.invert(false);
        flashtimer = 0;
        }
    
  // let's call my scrolling background
  scrollingbackground();
  
  if(arduboy.everyXFrames(2)) // when running at 60fps
  {
  ++shipFrame; // Add 1
  shipFrame %= 2; // Remainder of dividing by 2
  }

  if(arduboy.everyXFrames(5)) // when running at 60fps
  {
  ++enemyFrame; // Add 1
  enemyFrame %= 2; // Remainder of dividing by 2
  }
  
  if(arduboy.everyXFrames(7)) // when running at 60fps
  {
  ++heartFrame; // Add 1
  if(heartFrame > 3) { heartFrame = 0; } // resets frame to 0 if greater then 3
  }
  
  if(arduboy.everyXFrames(30)) // when running at 60fps
  {
  ++fuelFrame; // Add 1
  if(fuelFrame > 1) { fuelFrame = 0; } // resets every .5 seconds
  }

// Fuel timer count
  if(arduboy.everyXFrames(60)) // when running at 60fps
  {
  fuelcount = fuelcount + 2; // Add 2
  }

// handle collisions
  handleCollisions();
    
// display explosions if true
  explosions();
  
// display a heart being shot if true

  heartshot();
  
  drawPowerup();
  updatePowerup();

// falling heart display
  Sprites::drawExternalMask(heartx, hearty, heart, heartmask, heartFrame, heartFrame);
  
// enemies appearing
  Sprites::drawExternalMask(enemy1x, enemy1y, enemy1, enemy1mask, enemyFrame, enemyFrame);
  Sprites::drawExternalMask(enemy2x, enemy2y, enemy1, enemy1mask, enemyFrame, enemyFrame);
  
// resetting position for next enemy to appear
  enemy1y = enemy1y + speed;
  if( enemy1y > 64 ) {
  enemy1y = -28;
  enemy1x = random(26,87);
  }
  enemy2y = enemy2y + speed;
  if( enemy1y > 64 ) {
  enemy2y = -28;
  enemy2x = random(26,87);
  }
  
// resetting position for next heart to fall
  hearty = hearty + speed + 1;
  if( hearty > 64 ) {
  hearty = -28;
  heartx = random(26,87);
  }

  
// here i display the main sprite
  Sprites::drawExternalMask(player.x, player.y, player1, player1mask, shipFrame, shipFrame);
  
// Score area
  arduboy.fillRect(0, 0, 128, 10, BLACK);
  arduboy.setCursor(1, 0);
  arduboy.print(F("SCORE:")); arduboy.setCursor(37, 0);
  extractDigits(digits, score);
  for(uint8_t i = 5; i > 0; --i)
  arduboy.print(digits[i - 1]);
  arduboy.setCursor(78, 0);
  arduboy.print(F("SHIELD:"));
  arduboy.setCursor(120, 0);
  arduboy.print(shield);
  arduboy.drawLine(0, 9, 128, 9, WHITE);
  arduboy.drawLine(0, 10, 128, 10, BLACK);
  
// display the fuel gauge
  Sprites::drawExternalMask(119, 15, fuelgauge, fuelgaugemask, 0, 0);
  // makes the fuel decrease on screen according to the fuel timer
  arduboy.fillRect(121, 17, 3, fuelcount, BLACK);
    // make sure fuel don't overflow
    if(fuelcount < 1) {
    fuelcount = 0;
    }
    
      // Fuel Low Warning if needed
      if(fuelcount > 30) {
        if(fuelFrame < 1) {
        Sprites::drawExternalMask(player.x - 4, player.y + 6, lowfuel, lowfuelmask, 0, 0);
        }
      }
        // GameOver if out of fuel
        if(fuelcount > 40) {
        arduboy.digitalWriteRGB(RED_LED, RGB_OFF); // turn off LEDS
        arduboy.digitalWriteRGB(GREEN_LED, RGB_OFF); // turn off LEDS
        arduboy.digitalWriteRGB(BLUE_LED, RGB_OFF); // turn off LEDS
        state = 3;
        }
  
// what is happening when we press buttons
  if(arduboy.pressed(LEFT_BUTTON) && player.x > 18) {
        --player.x;
  }
    if(arduboy.pressed(RIGHT_BUTTON) && player.x < 92) {
        ++player.x;
    }
    if(arduboy.pressed(UP_BUTTON) && player.y > 10) {
        --player.y; 
    }
    if(arduboy.pressed(DOWN_BUTTON) && player.y < 49) {
        ++player.y;
    }
    
  if(arduboy.justPressed(B_BUTTON)) {
  sound.tone(NOTE_C4,70, NOTE_D5,50, NOTE_E6,70); state = 4;
  }

// check if speed increase triggered
  if(score >= 1500 && oldScore < 1500) { speed = 2; speedupdisplay(); }
  else if(score >= 1000 && oldScore < 1000) { speed = 1; speedupdisplay(); }
  else if(score >= 500 && oldScore < 500) { speed = 2; speedupdisplay(); }
  
}
