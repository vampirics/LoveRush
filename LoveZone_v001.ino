#include <Arduboy2.h>
#include <ArduboyTones.h>

#define EEPROM_START_C1                 (EEPROM_STORAGE_SPACE_START + 128)
#define EEPROM_START_C2                 (EEPROM_START_C1 + 1)
#define EEPROM_SCORE                    (EEPROM_START_C1 + 2)

Arduboy2 arduboy;
ArduboyTones sound(arduboy.audio.enabled);
Sprites sprite;

// setting up variables

struct Position {
  int8_t x;
  int8_t y;
};

Position player = { 54, 40 };
Position cloudl = { 0, 0 };
Position cloudr = { 103, 0 };

uint8_t state = 0;

// variable for Cloud backdrop
int8_t backdropx = -3;
int8_t backdropy = 0;

// variable for enemy position
int8_t enemy1x = random(26,87);
int8_t enemy1y = -14;
int8_t enemy2x = random(26,87);
int8_t enemy2y = -14;

// variable for heart position
int8_t heartx = random(26,87);
int8_t hearty = -14;

int score = 0;
int8_t lives = 3;
bool primed = false;

//highscore variable
unsigned int highScore = 0;

// storing sprites in PROGMEM
const unsigned char PROGMEM bootlogo[] =
{
// width, height,
//128, 64,
0x00, 0x00, 0x00, 0x00, 0x00, 0x00, 0x00, 0x00, 0x00, 0x00, 0x00, 0x00,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 0x00, 
0x00, 0x00, 0x00, 0x00, 0x00, 0x00, 0x00, 0x00, 0x00, 0x00, 0x00, 0x00,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 0x00, 
0x00, 0x00, 0x00, 0x00, 0x00, 0x00, 0x00, 0x00, 0x00, 0x00, 0x00, 0x00,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 0x00, 
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0x00, 0x00, 0x00, 0x00, 0x00, 0x00, 0x00, 0x00, 0x00, 0x00, 0x00, 0x00,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 0x00, 
};

const unsigned char PROGMEM splash[] =
{
// width, height,
//128, 64,
0x00, 0x00, 0x00, 0x00, 0x00, 0x00, 0x00, 0x00, 0x00, 0x00, 0x00, 0x00,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 0xff, 
0x00, 0x00, 0x00, 0x00, 0x00, 0x00, 0x00, 0x00, 0x00, 0x00, 0x00, 0x00,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 0xff, 
0x00, 0x00, 0x00, 0x00, 0x00, 0x00, 0x00, 0x00, 0x00, 0x00, 0x00, 0x00,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 0xff, 
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0xff, 0xff, 0xff, 0xff, 0xff, 0xff, 0xff, 0xfe, 0xfd, 0xfa, 0xf4, 0xe9,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 0x00, 
};

const unsigned char PROGMEM player1[] =
{
// width, height,
17, 15,
0x00, 0x80, 0x70, 0x40, 0xa0, 0x00, 0x60, 0xd0, 0xe6, 0xf0, 0x60, 0x00, 0xa0, 0x40, 0x70, 0x80, 0x00, 
0x00, 0x00, 0x09, 0x01, 0x03, 0x00, 0x01, 0x04, 0x09, 0x04, 0x01, 0x00, 0x03, 0x01, 0x09, 0x00, 0x00, 
};

const unsigned char PROGMEM player1mask[] =
{
// width, height,
//17, 15,
0x80, 0xf0, 0xf8, 0xf0, 0xf0, 0xe0, 0xf0, 0xfe, 0xff, 0xfe, 0xf0, 0xe0, 0xf0, 0xf0, 0xf8, 0xf0, 0x80, 
0x00, 0x09, 0x1f, 0x0b, 0x07, 0x03, 0x07, 0x0f, 0x1f, 0x0f, 0x07, 0x03, 0x07, 0x0b, 0x1f, 0x09, 0x00, 
};

const unsigned char PROGMEM player2[] =
{
// width, height,
17, 15,
0x00, 0x80, 0x70, 0x40, 0xa0, 0x00, 0x60, 0xd0, 0xe6, 0xf0, 0x60, 0x00, 0xa0, 0x40, 0x70, 0x80, 0x00, 
0x00, 0x00, 0x11, 0x01, 0x03, 0x00, 0x01, 0x08, 0x31, 0x08, 0x01, 0x00, 0x03, 0x01, 0x11, 0x00, 0x00, 
};

const unsigned char PROGMEM player2mask[] =
{
// width, height,
//17, 15,
0x80, 0xf0, 0xf8, 0xf0, 0xf0, 0xe0, 0xf0, 0xfe, 0xff, 0xfe, 0xf0, 0xe0, 0xf0, 0xf0, 0xf8, 0xf0, 0x80, 
0x00, 0x09, 0x1f, 0x0b, 0x07, 0x03, 0x03, 0x0b, 0x3b, 0x0b, 0x03, 0x03, 0x07, 0x0b, 0x1f, 0x09, 0x00, 
};

const unsigned char PROGMEM enemy1[] =
{
// width, height,
15, 30,
0x00, 0x40, 0x00, 0xe0, 0x00, 0x44, 0x00, 0xfe, 0x00, 0x44, 0x00, 0xe0, 0x00, 0x40, 0x00, 
0x00, 0xfa, 0x00, 0xff, 0x00, 0x52, 0x00, 0x7f, 0x00, 0x52, 0x00, 0xff, 0x00, 0xfa, 0x00, 
0x00, 0xc1, 0x78, 0xee, 0x84, 0xd4, 0x6e, 0x3f, 0x6e, 0xd4, 0x84, 0xee, 0x78, 0xc1, 0x00, 
0x00, 0x03, 0x03, 0x06, 0x0b, 0x0d, 0x1d, 0x1d, 0x1d, 0x0d, 0x0b, 0x06, 0x03, 0x03, 0x00, 
};

const unsigned char PROGMEM enemy1mask[] =
{
// width, height,
//15, 30,
0x40, 0xe0, 0xe0, 0xf0, 0xe4, 0xee, 0xfe, 0xff, 0xfe, 0xee, 0xe4, 0xf0, 0xe0, 0xe0, 0x40, 
0xfa, 0xff, 0xff, 0xff, 0xff, 0xff, 0x7f, 0xff, 0x7f, 0xff, 0xff, 0xff, 0xff, 0xff, 0xfa, 
0xc1, 0xff, 0xff, 0xff, 0xfe, 0xfe, 0xff, 0xff, 0xff, 0xfe, 0xfe, 0xff, 0xff, 0xff, 0xc1, 
0x03, 0x07, 0x07, 0x0f, 0x1f, 0x1f, 0x3f, 0x3f, 0x3f, 0x1f, 0x1f, 0x0f, 0x07, 0x07, 0x03, 
};

const unsigned char PROGMEM heart[] =
{
// width, height,
16, 14,
0x00, 0x70, 0x88, 0x74, 0xda, 0xaa, 0x4a, 0x94, 0x14, 0x0a, 0x0a, 0x8a, 0x74, 0x88, 0x70, 0x00, 
0x00, 0x00, 0x00, 0x01, 0x02, 0x05, 0x0b, 0x16, 0x15, 0x0a, 0x05, 0x02, 0x01, 0x00, 0x00, 0x00, 
};

const unsigned char PROGMEM heartmask[] =
{
// width, height,
//16, 14,
0x70, 0xf8, 0xfc, 0xfe, 0xff, 0xff, 0xff, 0xfe, 0xfe, 0xff, 0xff, 0xff, 0xfe, 0xfc, 0xf8, 0x70, 
0x00, 0x00, 0x01, 0x03, 0x07, 0x0f, 0x1f, 0x3f, 0x3f, 0x1f, 0x0f, 0x07, 0x03, 0x01, 0x00, 0x00, 
};

const unsigned char PROGMEM cloudborderl[] =
{
// width, height,
25, 64,
0xff, 0xff, 0xff, 0xff, 0xff, 0xff, 0xff, 0xff, 0xff, 0xff, 0xff, 0xff, 0xfe, 0xfe, 0xfd, 0xfd, 0xfb, 0xe1, 0x80, 0x00, 0x00, 0x00, 0x00, 0x00, 0x00, 
0xff, 0xff, 0xff, 0xff, 0xff, 0xff, 0xff, 0xff, 0xff, 0xff, 0xff, 0xff, 0xff, 0xff, 0xff, 0xff, 0xbf, 0xcf, 0xc7, 0x80, 0x00, 0x00, 0x00, 0x00, 0x00, 
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0xff, 0xff, 0xff, 0xff, 0xff, 0xff, 0xff, 0xff, 0xff, 0xff, 0xff, 0xff, 0x7f, 0x7f, 0xbf, 0xbf, 0xdf, 0xe7, 0x01, 0x00, 0x00, 0x00, 0x00, 0x00, 0x00, 
};

const unsigned char PROGMEM cloudbackdrop[] =
{
// width, height,
128, 64,
0x00, 0x00, 0x00, 0x00, 0x00, 0x00, 0x00, 0x00, 0x00, 0x00, 0x00, 0x00,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 0x00, 
0x00, 0x00, 0x00, 0x00, 0x00, 0x00, 0x00, 0x00, 0x00, 0x00, 0x00, 0x00,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 0x00, 
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0x00, 0x00, 0x00, 0x00, 0x00, 0x00, 0x00, 0x00, 0x00, 0x00, 0x00, 0x00,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 0x00, 
};

const unsigned char PROGMEM cloudborderlmask[] =
{
// width, height,
//25, 64,
0xff, 0xff, 0xff, 0xff, 0xff, 0xff, 0xff, 0xff, 0xff, 0xff, 0xff, 0xff, 0xff, 0xff, 0xff, 0xff, 0xff, 0xfb, 0xe1, 0x80, 0x00, 0x00, 0x00, 0x00, 0x00, 
0xff, 0xff, 0xff, 0xff, 0xff, 0xff, 0xff, 0xff, 0xff, 0xff, 0xff, 0xff, 0xff, 0xff, 0xff, 0xff, 0xff, 0xff, 0xef, 0xc7, 0x80, 0x00, 0x00, 0x00, 0x00, 
0xff, 0xff, 0xff, 0xff, 0xff, 0xff, 0xff, 0xff, 0xff, 0xff, 0xff, 0xff, 0xff, 0xff, 0xff, 0xff, 0xff, 0xff, 0xff, 0xdf, 0x8f, 0x07, 0x00, 0x00, 0x00, 
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0xff, 0xff, 0xff, 0xff, 0xff, 0xff, 0xff, 0xff, 0xff, 0xff, 0xff, 0xff, 0xff, 0xff, 0xff, 0xff, 0xff, 0xff, 0xe7, 0x01, 0x00, 0x00, 0x00, 0x00, 0x00, 
};

const unsigned char PROGMEM cloudborderr[] =
{
25, 64,
0x00, 0x00, 0x00, 0x00, 0x00, 0x00, 0x80, 0xe7, 0xfb, 0xfd, 0xfd, 0xfe, 0xfe, 0xff, 0xff, 0xff, 0xff, 0xff, 0xff, 0xff, 0xff, 0xff, 0xff, 0xff, 0xff, 
0x00, 0x00, 0x80, 0xc0, 0xe0, 0xf7, 0xfb, 0xfb, 0xff, 0xff, 0xff, 0xff, 0xff, 0xff, 0xff, 0xff, 0xff, 0xff, 0xff, 0xff, 0xff, 0xff, 0xff, 0xff, 0xff, 
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0x00, 0x00, 0x00, 0x00, 0x00, 0x00, 0x01, 0x87, 0xdf, 0xbf, 0xbf, 0x7f, 0x7f, 0xff, 0xff, 0xff, 0xff, 0xff, 0xff, 0xff, 0xff, 0xff, 0xff, 0xff, 0xff, 
};

const unsigned char PROGMEM cloudborderrmask[] =
{
//25, 64,
0x00, 0x00, 0x00, 0x00, 0x00, 0x80, 0xe7, 0xff, 0xff, 0xff, 0xff, 0xff, 0xff, 0xff, 0xff, 0xff, 0xff, 0xff, 0xff, 0xff, 0xff, 0xff, 0xff, 0xff, 0xff, 
0x00, 0x80, 0xc0, 0xe0, 0xf7, 0xff, 0xff, 0xff, 0xff, 0xff, 0xff, 0xff, 0xff, 0xff, 0xff, 0xff, 0xff, 0xff, 0xff, 0xff, 0xff, 0xff, 0xff, 0xff, 0xff, 
0x00, 0x07, 0x0f, 0x1f, 0x3f, 0x7f, 0xff, 0xff, 0xff, 0xff, 0xff, 0xff, 0xff, 0xff, 0xff, 0xff, 0xff, 0xff, 0xff, 0xff, 0xff, 0xff, 0xff, 0xff, 0xff, 
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0x00, 0x00, 0x00, 0x00, 0x00, 0x01, 0x87, 0xdf, 0xff, 0xff, 0xff, 0xff, 0xff, 0xff, 0xff, 0xff, 0xff, 0xff, 0xff, 0xff, 0xff, 0xff, 0xff, 0xff, 0xff, 
};

void initEEPROM() {
  char c1 = EEPROM.read(EEPROM_START_C1);
  char c2 = EEPROM.read(EEPROM_START_C2);

  highScore = 0;
  
  if (c1 != 'L' || c2 != 'Z') {
  EEPROM.update(EEPROM_START_C1, 'L');
  EEPROM.update(EEPROM_START_C2, 'Z');
  }
    else {
    EEPROM.get(EEPROM_STORAGE_SPACE_START, highScore);
    }
}

void setup() {
  // put your setup code here, to run once:
  arduboy.begin();
  arduboy.clear();
  arduboy.drawBitmap(0, 0, bootlogo, 128, 64, WHITE);
  arduboy.display();
  initEEPROM();
  delay(3500);
  
  // limits the frames per second
  arduboy.setFrameRate(60);
}

void loop() {
  // put your main code here, to run repeatedly:
  
  // Wait for the next frame
   if (!(arduboy.nextFrame())) return;
  
  arduboy.pollButtons();
  arduboy.clear();

  if (state == 0)  { doSplash(); }
  else if (state == 1)  { gameplay(); }
  else if (state == 2)  { gameover(); }
  else if (state == 3)  { pause(); }
  
  arduboy.display();
}

  // Pause state
void pause() {
  arduboy.setCursor(37, 30);
  arduboy.print(F("* PAUSE *"));
  sprite.drawExternalMask(10, 27, heart, heartmask, 0, 0);
  sprite.drawExternalMask(100, 27, heart, heartmask, 0, 0);

  // If 'B' button is pressed move back to gameplay
  if (arduboy.justPressed(B_BUTTON))  { state = 1; }

}

  // Splashscreen state
void doSplash() {
    
  // Reset highScore value option
  if(!primed) {
  if (arduboy.justPressed(B_BUTTON))
  {
    primed = true;
  }
}
else {
  if (arduboy.justPressed(DOWN_BUTTON))
  {
    highScore = 0;
    EEPROM.put(EEPROM_STORAGE_SPACE_START, highScore);
    primed = false;
}
  else if (arduboy.justPressed(B_BUTTON)) {
    primed = false;
  }

  // Display a warning
  // Might want to change the position
  arduboy.setCursor(1, 1);
  arduboy.print(F("DOWN:DEL."));
  arduboy.setCursor(51, 1);
  arduboy.print(F("B:CANCEL"));
}

  arduboy.drawBitmap(0, 0, splash, 128, 64, WHITE);

  // If 'A' button is pressed move to gameplay
  if (arduboy.justPressed(A_BUTTON))  { score = 0; lives = 3; state = 1; }

}

  // Gameover state
  void gameover() {
  if (score > highScore) {
    highScore = score; EEPROM.put(EEPROM_STORAGE_SPACE_START, highScore);
  }
  arduboy.setCursor(25, 20);
  arduboy.print(F("* GAME OVER *"));arduboy.setCursor(25, 40);
  arduboy.print(F("SCORE:")); arduboy.setCursor(60, 40); arduboy.print(score);
  arduboy.setCursor(25, 50);
  arduboy.print(F("HIGHSCORE:")); arduboy.setCursor(85, 50); arduboy.print(highScore);
  sprite.drawExternalMask(5, 10, enemy1, enemy1mask, 0, 0);
  sprite.drawExternalMask(108, 10, enemy1, enemy1mask, 0, 0);
  
  // If 'A' button is pressed move to splash
  if (arduboy.justPressed(A_BUTTON))  { state = 0; score = 0; }
}

  // gameplay state
void gameplay() {
    
  // here i display the background
  arduboy.drawBitmap(backdropx, backdropy, cloudbackdrop, 128, 64, WHITE);
  arduboy.drawBitmap(backdropx, backdropy - 64, cloudbackdrop, 128, 64, WHITE);
  sprite.drawExternalMask(cloudl.x, cloudl.y, cloudborderl, cloudborderlmask, 0, 0);
  sprite.drawExternalMask(cloudr.x, cloudr.y, cloudborderr, cloudborderrmask, 0, 0);
  sprite.drawExternalMask(cloudl.x, cloudl.y - 64, cloudborderl, cloudborderlmask, 0, 0);
  sprite.drawExternalMask(cloudr.x, cloudr.y - 64, cloudborderr, cloudborderrmask, 0, 0);
  sprite.drawExternalMask(cloudl.x, cloudl.y + 64, cloudborderl, cloudborderlmask, 0, 0);
  sprite.drawExternalMask(cloudr.x, cloudr.y + 64, cloudborderr, cloudborderrmask, 0, 0);
  
  // background scrolling loop
  backdropy = backdropy +1;
  if( backdropy > 64 ) {
  backdropy = 0;
  }
  cloudl.y = cloudl.y +2;
  cloudr.y = cloudr.y +2;
  if( cloudl.y > 64 ) {
  cloudl.y = 0;
  }
  if( cloudr.y > 64 ) {
  cloudr.y = 0;
  }

  // falling heart display
  sprite.drawExternalMask(heartx, hearty, heart, heartmask, 0, 0);
  
  // enemies appearing
  sprite.drawExternalMask(enemy1x, enemy1y, enemy1, enemy1mask, 0, 0);
  sprite.drawExternalMask(enemy2x, enemy2y, enemy1, enemy1mask, 0, 0);
  
  // resetting position for next enemy to appear
  enemy1y = enemy1y +1;
  if( enemy1y > 64 ) {
  enemy1y = -14; enemy1x = random(26,87);
  }
  enemy2y = enemy2y +1;
  if( enemy1y > 64 ) {
  enemy2y = -14; enemy2x = random(26,87);
  }
  
  // resetting position for next heart to fall
  hearty = hearty +2;
  if( hearty > 64 ) {
  hearty = -14; heartx = random(26,87);
  }
  // here i display the main sprite
  sprite.drawExternalMask(player.x, player.y, player1, player1mask, 0, 0);
  
  //Score rectangle area
  arduboy.fillRect(0, 0, 128, 10, BLACK);
  arduboy.setCursor(1, 1);
  arduboy.print(F("SCORE:")); arduboy.setCursor(37, 1); arduboy.print(score);
  arduboy.setCursor(85, 1);
  arduboy.print(F("SHIPS:")); arduboy.setCursor(120, 1); arduboy.print(lives);
  
// checking for collisions
  Rect playerRect = { player.x + 5, player.y + 5, 12, 11 };
  Rect enemy1Rect = { enemy1x + 5, enemy1y + 20, 10, 10 };
  Rect enemy2Rect = { enemy2x + 5, enemy2y + 20, 10, 10 };
  Rect heartRect = { heartx + 5, hearty + 5, 11, 9 };
  
  if(arduboy.collide(playerRect, heartRect)) {
  score = score + 5; sound.tone(NOTE_C4,100, NOTE_E4,100, NOTE_G4,100); hearty = -14; heartx = random(26,87);
  }

  if(arduboy.collide(playerRect, enemy1Rect)) {
  lives = lives - 1; sound.tone(NOTE_C4,100, NOTE_C4,100, NOTE_C4,100); enemy1y = -14; enemy1x = random(26,87);
  }
  
    if(arduboy.collide(playerRect, enemy2Rect)) {
  lives = lives - 1; sound.tone(NOTE_C4,100, NOTE_C4,100, NOTE_C4,100); enemy2y = -14; enemy2x = random(26,87);
  }
  
  // what is happening when we press buttons
  if(arduboy.pressed(LEFT_BUTTON) && player.x > 18) {
        player.x = player.x - 1;
  }
    if(arduboy.pressed(RIGHT_BUTTON) && player.x < 92) {
        player.x = player.x + 1;
    }
    if(arduboy.pressed(UP_BUTTON) && player.y > 10) {
        player.y = player.y - 1; 
    }
    if(arduboy.pressed(DOWN_BUTTON) && player.y < 49) {
        player.y = player.y + 1;
    }
    if(arduboy.justPressed(A_BUTTON)) {
        sound.tone(NOTE_C4,100, NOTE_E4,100, NOTE_G4,100);
        arduboy.setCursor(60, 1); arduboy.drawLine(player.x + 8, player.y - 1, player.x + 8, 10, WHITE);
        Rect laserRect = { player.x + 8, player.y - 64, 2, 64 };
        if(arduboy.collide(laserRect, enemy1Rect)) {
        score = score + 10; sound.tone(NOTE_C4,100, NOTE_D4,80, NOTE_E4,50); enemy1y = -14; enemy1x = random(26,87);
        }
        if(arduboy.collide(laserRect, enemy2Rect)) {
        score = score + 10; sound.tone(NOTE_C4,100, NOTE_D4,80, NOTE_E4,50); enemy2y = -14; enemy2x = random(26,87);
        }
    }
    if(arduboy.justPressed(B_BUTTON)) {
        sound.tone(NOTE_C4,70, NOTE_E4,70, NOTE_G4,7); state = 3;
    }
  
  // check is game is over
  if(lives < 0) { state = 2; }
}
